## build/right/Kconfig/Kconfig.modules
```kconfig
menu "nanopb (/Users/haroldhernandez/totem/zmk-config-totem/modules/lib/nanopb)"
osource "$(ZEPHYR_NANOPB_KCONFIG)"
config ZEPHYR_NANOPB_MODULE
	bool
	default y
endmenu
menu "acpica (/Users/haroldhernandez/totem/zmk-config-totem/modules/lib/acpica)"
osource "$(ZEPHYR_ACPICA_KCONFIG)"
config ZEPHYR_ACPICA_MODULE
	bool
	default y
endmenu
menu "canopennode (/Users/haroldhernandez/totem/zmk-config-totem/modules/lib/canopennode)"
osource "$(ZEPHYR_CANOPENNODE_KCONFIG)"
config ZEPHYR_CANOPENNODE_MODULE
	bool
	default y
endmenu
menu "cmsis (/Users/haroldhernandez/totem/zmk-config-totem/modules/hal/cmsis)"
osource "$(ZEPHYR_CMSIS_KCONFIG)"
config ZEPHYR_CMSIS_MODULE
	bool
	default y
endmenu
menu "cmsis-dsp (/Users/haroldhernandez/totem/zmk-config-totem/modules/lib/cmsis-dsp)"
osource "$(ZEPHYR_CMSIS_DSP_KCONFIG)"
config ZEPHYR_CMSIS_DSP_MODULE
	bool
	default y
endmenu
menu "cmsis-nn (/Users/haroldhernandez/totem/zmk-config-totem/modules/lib/cmsis-nn)"
osource "$(ZEPHYR_CMSIS_NN_KCONFIG)"
config ZEPHYR_CMSIS_NN_MODULE
	bool
	default y
endmenu
menu "fatfs (/Users/haroldhernandez/totem/zmk-config-totem/modules/fs/fatfs)"
osource "$(ZEPHYR_FATFS_KCONFIG)"
config ZEPHYR_FATFS_MODULE
	bool
	default y
endmenu
menu "hal_ambiq (/Users/haroldhernandez/totem/zmk-config-totem/modules/hal/ambiq)"
osource "$(ZEPHYR_HAL_AMBIQ_KCONFIG)"
config ZEPHYR_HAL_AMBIQ_MODULE
	bool
	default y
endmenu
menu "hal_espressif (/Users/haroldhernandez/totem/zmk-config-totem/modules/hal/espressif)"
osource "/Users/haroldhernandez/totem/zmk-config-totem/modules/hal/espressif/zephyr/Kconfig"
config ZEPHYR_HAL_ESPRESSIF_MODULE
	bool
	default y
endmenu
menu "hal_ethos_u (/Users/haroldhernandez/totem/zmk-config-totem/modules/hal/ethos_u)"
osource "$(ZEPHYR_HAL_ETHOS_U_KCONFIG)"
config ZEPHYR_HAL_ETHOS_U_MODULE
	bool
	default y
endmenu
menu "hal_gigadevice (/Users/haroldhernandez/totem/zmk-config-totem/modules/hal/gigadevice)"
osource "$(ZEPHYR_HAL_GIGADEVICE_KCONFIG)"
config ZEPHYR_HAL_GIGADEVICE_MODULE
	bool
	default y
endmenu
menu "hal_nordic (/Users/haroldhernandez/totem/zmk-config-totem/modules/hal/nordic)"
osource "$(ZEPHYR_HAL_NORDIC_KCONFIG)"
config ZEPHYR_HAL_NORDIC_MODULE
	bool
	default y
endmenu
menu "hal_rpi_pico (/Users/haroldhernandez/totem/zmk-config-totem/modules/hal/rpi_pico)"
osource "$(ZEPHYR_HAL_RPI_PICO_KCONFIG)"
config ZEPHYR_HAL_RPI_PICO_MODULE
	bool
	default y
endmenu
menu "hal_telink (/Users/haroldhernandez/totem/zmk-config-totem/modules/hal/telink)"
osource "/Users/haroldhernandez/totem/zmk-config-totem/modules/hal/telink/Kconfig"
config ZEPHYR_HAL_TELINK_MODULE
	bool
	default y
endmenu
menu "liblc3 (/Users/haroldhernandez/totem/zmk-config-totem/modules/lib/liblc3)"
osource "$(ZEPHYR_LIBLC3_KCONFIG)"
config ZEPHYR_LIBLC3_MODULE
	bool
	default y
endmenu
menu "littlefs (/Users/haroldhernandez/totem/zmk-config-totem/modules/fs/littlefs)"
osource "$(ZEPHYR_LITTLEFS_KCONFIG)"
config ZEPHYR_LITTLEFS_MODULE
	bool
	default y
endmenu
menu "lvgl (/Users/haroldhernandez/totem/zmk-config-totem/modules/lib/gui/lvgl)"
osource "/Users/haroldhernandez/totem/zmk-config-totem/modules/lib/gui/lvgl/Kconfig"
config ZEPHYR_LVGL_MODULE
	bool
	default y
endmenu
menu "mbedtls (/Users/haroldhernandez/totem/zmk-config-totem/modules/crypto/mbedtls)"
osource "$(ZEPHYR_MBEDTLS_KCONFIG)"
config ZEPHYR_MBEDTLS_MODULE
	bool
	default y
endmenu
menu "percepio (/Users/haroldhernandez/totem/zmk-config-totem/modules/debug/percepio)"
osource "/Users/haroldhernandez/totem/zmk-config-totem/modules/debug/percepio/zephyr/Kconfig"
config ZEPHYR_PERCEPIO_MODULE
	bool
	default y
endmenu
menu "picolibc (/Users/haroldhernandez/totem/zmk-config-totem/modules/lib/picolibc)"
osource "/Users/haroldhernandez/totem/zmk-config-totem/modules/lib/picolibc/zephyr/Kconfig"
config ZEPHYR_PICOLIBC_MODULE
	bool
	default y
endmenu
menu "segger (/Users/haroldhernandez/totem/zmk-config-totem/modules/debug/segger)"
osource "$(ZEPHYR_SEGGER_KCONFIG)"
config ZEPHYR_SEGGER_MODULE
	bool
	default y
endmenu
menu "trusted-firmware-a (/Users/haroldhernandez/totem/zmk-config-totem/modules/tee/tf-a/trusted-firmware-a)"
osource "$(ZEPHYR_TRUSTED_FIRMWARE_A_KCONFIG)"
config ZEPHYR_TRUSTED_FIRMWARE_A_MODULE
	bool
	default y
endmenu
menu "uoscore-uedhoc (/Users/haroldhernandez/totem/zmk-config-totem/modules/lib/uoscore-uedhoc)"
osource "$(ZEPHYR_UOSCORE_UEDHOC_KCONFIG)"
config ZEPHYR_UOSCORE_UEDHOC_MODULE
	bool
	default y
endmenu
menu "zcbor (/Users/haroldhernandez/totem/zmk-config-totem/modules/lib/zcbor)"
osource "$(ZEPHYR_ZCBOR_KCONFIG)"
config ZEPHYR_ZCBOR_MODULE
	bool
	default y
endmenu
menu "module (/Users/haroldhernandez/totem/zmk-config-totem/zmk/app/module)"
osource "/Users/haroldhernandez/totem/zmk-config-totem/zmk/app/module/Kconfig"
config ZEPHYR_MODULE_MODULE
	bool
	default y
endmenu
```

## build/right/Kconfig/Kconfig.shield
```kconfig
osource "/Users/haroldhernandez/totem/zmk-config-totem/zmk/app/boards/shields/*/Kconfig.shield"
osource "/Users/haroldhernandez/totem/zmk-config-totem/config/boards/shields/*/Kconfig.shield"
```

## build/right/Kconfig/Kconfig.shield.defconfig
```kconfig
osource "/Users/haroldhernandez/totem/zmk-config-totem/zmk/app/boards/shields/*/Kconfig.defconfig"
osource "/Users/haroldhernandez/totem/zmk-config-totem/config/boards/shields/*/Kconfig.defconfig"
```

## config/Kconfig.custom_combo
```kconfig
menuconfig ZMK_CUSTOM_COMBO
    bool "Custom Combo Support"
    default y
    select ZMK_BEHAVIOR
    help
      Enable support for custom combo behavior with mixed release timing.

if ZMK_CUSTOM_COMBO

config ZMK_CUSTOM_COMBO_MAX_KEYS
    int "Maximum number of keys in a custom combo"
    default 10
    help
      Maximum number of keys that can be pressed simultaneously in a custom combo.

endif # ZMK_CUSTOM_COMBO 
```

## config/dts/bindings/behaviors/dual_release_combo.yaml
```yaml
# SPDX-License-Identifier: MIT
---
description: |
  Custom ZMK behavior that presses two bindings when its combo fires.
  The *quick* binding is released on the first key-up of the combo while
  the *slow* binding is held until the last key-up.

compatible: "zmk,behavior-dual-release-combo"

include: base.yaml

properties:
  "#binding-cells":
    type: int
    const: 0
    description: |
      This behaviour is referenced without additional cells.

  bindings:
    type: phandle-array
    required: true
    description: |
      Two phandles describing: 0 – slow-release binding, 1 – quick-release binding.

  key-positions:
    type: array
    required: true
    description: List of key position numbers that form the combo.
```

## config/dual_release_combo/dts/bindings/behaviors/dual_release_combo.yaml
```yaml
# SPDX-License-Identifier: MIT
---
compatible: "zmk,behavior-dual-release-combo"

description: |
  Custom ZMK behavior that presses two bindings when its combo fires.
  The quick binding is released on the first key-up of the combo while
  the slow binding is held until the last key-up.

include: base.yaml

properties:
  "#binding-cells":
    const: 0
    description: |
      This behaviour is referenced without additional cells.
```

## config/west.yml
```yaml
manifest:
  remotes:
    - name: zmkfirmware
      url-base: https://github.com/zmkfirmware
    - name: urob
      url-base: https://github.com/urob
  projects:
    - name: zmk
      remote: urob
      revision: v0.2+fix-child-nodes
      import: app/west.yml
    - name: zmk-leader-key
      remote: urob
      revision: v0.2 # set to same as ZMK version above
  self:
    path: config
```
