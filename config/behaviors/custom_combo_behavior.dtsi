/*
 * Copyright (c) 2024 The ZMK Contributors
 *
 * SPDX-License-Identifier: MIT
 */

/ {
    behaviors {
        custom_combo: custom_combo {
            compatible = "zmk,behavior-custom-combo";
            #binding-cells = <2>;
            bindings = <&mo>, <&kp>;
            quick-release-binding = <1>;
            hold-release-binding = <0>;
            label = "CUSTOM_COMBO";
        };
    };
}; 