#include <zephyr/logging/log.h>
LOG_MODULE_REGISTER(dual_rl_combo, CONFIG_ZMK_LOG_LEVEL);

/ {
    behaviors {
        dual_release_combo: dual_release_combo {
            compatible = "zmk,behavior-dual-release-combo";
            /* Two cell parameters: <slow_binding quick_binding> */
            #binding-cells = <0>;
            label = "DUAL_RELEASE_COMBO";
            bindings = <&mo LOWER>, <&kp LEFT>;
            key-positions = <27 35>;
        };
    };
}; 