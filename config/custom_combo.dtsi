/*
 * Copyright (c) 2024 The ZMK Contributors
 *
 * SPDX-License-Identifier: MIT
 */

#include <behaviors.dtsi>
#include <dt-bindings/zmk/keys.h>

/ {
    behaviors {
        /*
         * Custom combo behavior that allows for mixed release timing
         * - First binding is released immediately when any key is released
         * - Second binding is held until all keys are released
         */
        custom_combo: custom_combo {
            compatible = "zmk,behavior-custom-combo";
            #binding-cells = <2>;
            bindings = <&kp>, <&mo>;
            timeout-ms = <2000>;
            require-prior-idle-ms = <150>;
            layers = <0x0 0x18>; // BASE (0) and DRAGTHUMB (24)
            label = "CUSTOM_COMBO";
        };
    };
}; 