        
#define COMBO(NAME, BINDINGS, KEYPOS) \
  combo_##NAME { \
    timeout-ms = <199>; \
    bindings = <BINDINGS>; \
    key-positions = <KEYPOS>; \
    slow-release; \
    layers = <BASE>; \
  };
#define RCOMBOACT(NAME, BINDINGS, KEYPOS) \
  combo_##NAME { \
    timeout-ms = <2000>; \
    bindings = <BINDINGS>; \
    key-positions = <KEYPOS>; \
    slow-release; \
    layers = <BASE NAVOVERR DIRECTACC HOMEROW RAISE LOWER FUNC>; \
  };
#define RCOMBO(NAME, BINDINGS, KEYPOS) \
  combo_##NAME { \
    timeout-ms = <500>; \
    bindings = <BINDINGS>; \
    key-positions = <KEYPOS>; \
    require-prior-idle-ms = <150>; \
    layers = <BASE NAVOVERR DIRECTACC HOMEROW RAISE LOWER FUNC>; \
  };
#define NAVBACOMBO(NAME, BINDINGS, KEYPOS) \
  combo_##NAME { \
    timeout-ms = <200>; \
    bindings = <BINDINGS>; \
    key-positions = <KEYPOS>; \
    layers = <NAVOVERR>; \
  };
#define COMBODIRECTACC(NAME, BINDINGS, KEYPOS) \
  combo_##NAME { \
    timeout-ms = <500>; \
    bindings = <BINDINGS>; \
    key-positions = <KEYPOS>; \
    layers = <DIRECTACC>; \
  };
#define COMBOADJ(NAME, BINDINGS, KEYPOS) \
  combo_##NAME { \
    timeout-ms = <500>; \
    bindings = <BINDINGS>; \
    key-positions = <KEYPOS>; \
    layers = <ADJ>; \
  };
#define COMBOTS(NAME, BINDINGS, KEYPOS) \
  combo_##NAME { \
    timeout-ms = <500>; \
    bindings = <BINDINGS>; \
    key-positions = <KEYPOS>; \
    layers = <TILDESHIFT>; \
  };


#define CBKS(BINDINGS, KEYPOS) \
  cbks_##KEYPOS { \
    timeout-ms = <2000>; \
    bindings = <BINDINGS>; \
    key-positions = <KEYPOS 33>; \
    key-positions-leader = <KEYPOS>; \
  };
#define CTKSPA(BINDINGS, KEYPOS) \
  ctkspa_##KEYPOS { \
    timeout-ms = <2000>; \
    bindings = <&mo DIRECTACC>, <BINDINGS>; \
    key-positions = <KEYPOS 33>; \
    key-positions-leader = <KEYPOS>; \
    slow-release; \
  };
#define CBKL(BINDINGS, KEYPOS) \
  ctkspal_##KEYPOS { \
    timeout-ms = <2000>; \
    bindings = <BINDINGS>; \
    key-positions = <KEYPOS 33>; \
    key-positions-leader = <KEYPOS>; \
    slow-release; \
  };
#define CTAB(BINDINGS, KEYPOS) \
  ctab_##KEYPOS { \
    timeout-ms = <2000>; \
    bindings = <&mo LOWER>, <BINDINGS>; \
    key-positions = <KEYPOS 34>; \
    key-positions-leader = <KEYPOS>; \
    slow-release; \
  };
#define CTABD(BINDINGS, KEYPOS) \
  ctabd_##KEYPOS { \
    timeout-ms = <2000>; \
    bindings = <BINDINGS>; \
    key-positions = <KEYPOS 34>; \
    key-positions-leader = <KEYPOS>; \
    slow-release; \
  };

#define CENT(BINDINGS, KEYPOS) \
  cent_##KEYPOS { \
    timeout-ms = <2000>; \
    bindings = <&mo RAISE>, <BINDINGS>; \
    key-positions = <KEYPOS 35>; \
    key-positions-leader = <KEYPOS>; \
    slow-release; \
  };
#define CSPC(BINDINGS, KEYPOS) \
  cspc_##KEYPOS { \
    timeout-ms = <2000>; \
    bindings = <&mo NUMBERS>, <BINDINGS>; \
    key-positions = <KEYPOS 36>; \
    key-positions-leader = <KEYPOS>; \
    slow-release; \
  };
#define CSPCS(BINDINGS, KEYPOS) \
  cspcs_##KEYPOS { \
    timeout-ms = <350>; \
    bindings = <&mo NUMBERS>, <BINDINGS>; \
    key-positions = <KEYPOS 36>; \
    key-positions-leader = <KEYPOS>; \
  };

    combos {
        compatible = "zmk,combos";
        //LEFT HAND

        RCOMBOACT(comb_wf, &kp ESC, 0 1 2)// Q W F
        RCOMBOACT(comb_fp, &kp SPACE, 1 2 3)// W F P
        RCOMBOACT(comb_pb, &kp ENTER, 3 4)// P B
        RCOMBOACT(comb_pb_2, &kp ENTER, 12 3 13)// SPTwfp///
        RCOMBOACT(comb_tg_2, &kp TAB, 23 13 24)// CDT
        RCOMBOACT(comb_tg, &kp TAB, 24 25)// DV
        RCOMBOACT(comb_cd, &kp BACKSPACE, 22 23 24)// X C D
        RCOMBOACT(comb_xc, &kp DELETE, 21 22 23)// Z X C
        RCOMBO(comb_gv, &kp MINUS, 14 25)// G V
        RCOMBO(comb_td, &kp GRAVE, 13 24)// T D 
        RCOMBO(comb_sc, &kp RBKT, 12 23)// S C
        RCOMBO(comb_rx, &kp LBKT, 11 22)// R X
        RCOMBO(comb_az, &kp BSLH, 10 21)// A Z
        //RIGHT HAND

        RCOMBO(requal, &kp EQUAL, 15 26)
        RCOMBO(rsemi, &kp SEMI, 16 27)
        RCOMBO(SEMI, &kp COMMA, 17 28)
        RCOMBO(COLON, &kp DOT, 18 29)
        RCOMBO(FSLH, &kp FSLH, 19 30)

        //NUMBERS

        RCOMBO(NUM1, &kp N1, 0 10)
        RCOMBO(NUM2, &kp N2, 1 11)
        RCOMBO(NUM3, &kp N3, 2 12)
        RCOMBO(NUM4, &kp N4, 3 13)
        RCOMBO(NUM5, &kp N5, 4 14)
        RCOMBO(NUM6, &kp N6, 5 15)
        RCOMBO(NUM7, &kp N7, 6 16)
        RCOMBO(NUM8, &kp N8, 7 17) 
        RCOMBO(NUM9, &kp N9, 8 18)
        RCOMBO(NUM0, &kp N0, 9 19)

        //NavOverR

        NAVBACOMBO(pg_0, &kp HOME, 27 28)// H , 
        NAVBACOMBO(pg_1, &kp END, 28 29)// , .
        NAVBACOMBO(pg_4, &kp PG_UP, 27 18)// , H 
        NAVBACOMBO(pg_5, &kp PG_DN, 18 29)// H .
        // ADJUST

        COMBODIRECTACC(adj_tog_on, &tog_on ADJ,  0  1  2  3 )
        COMBOADJ(adj_tog_off, &tog_off ADJ,  0  1  2  3 )


        //     0  1  2  3  4     5  6  7  8  9
        //    10 11 12 13 14    15 16 17 18 19
        //20  21 22 23 24 25    26 27 28 29 30  31
        //        32 33 34         35 36 37


        /////////////////
        //START Dragmod//
        /////////////////

        c-hr-thumb-ar {
            bindings = <&kp LS(LCTRL)>;
            key-positions = <34 10 11>;
            layers = <BASE>;
            slow-release;
            timeout-ms = <2000>;
        };

        c-hr-thumb-ars {
            bindings = <&kp LS(LA(LCTRL))>;
            key-positions = <34 10 11 12>;
            layers = <BASE>;
            slow-release;
            timeout-ms = <2000>;
        };

        c-hr-thumb-arst {
            bindings = <&kp LS(LA(LG(LCTRL)))>;
            key-positions = <34 10 11 12 13>;
            layers = <BASE>;
            slow-release;
            timeout-ms = <2000>;
        };

        c-hr-thumb-art {
            bindings = <&kp LS(LC(LCMD))>;
            key-positions = <34 10 11 13>;
            layers = <BASE>;
            slow-release;
            timeout-ms = <2000>;
        };

        c-hr-thumb-ast {
            bindings = <&kp LS(LA(LCMD))>;
            key-positions = <34 10 13 12>;
            layers = <BASE>;
            slow-release;
            timeout-ms = <2000>;
        };

        c-hr-thumb-rst {
            bindings = <&kp LA(LC(LCMD))>;
            key-positions = <34 13 12 11>;
            layers = <BASE>;
            slow-release;
            timeout-ms = <2000>;
        };

        c-hr-thumb-at {
            bindings = <&kp LS(LCMD)>;
            key-positions = <34 13 10>;
            layers = <BASE>;
            slow-release;
            timeout-ms = <2000>;
        };

        c-hr-thumb-st {
            bindings = <&kp LA(LCMD)>;
            key-positions = <34 12 13>;
            layers = <BASE>;
            slow-release;
            timeout-ms = <2000>;
        };

        c-hr-thumb-rs {
            bindings = <&kp LC(LALT)>;
            key-positions = <34 12 11>;
            layers = <BASE>;
            slow-release;
            timeout-ms = <2000>;
        };

        c-hr-thumb-rt {
            bindings = <&kp LC(LCMD)>;
            key-positions = <34 13 11>;
            layers = <BASE>;
            slow-release;
            timeout-ms = <2000>;
        };

        c-hr-thumb-as {
            bindings = <&kp LS(LALT)>;
            key-positions = <34 10 12>;
            layers = <BASE>;
            slow-release;
            timeout-ms = <2000>;
        };

        ///////////////
        //END Dragmod//
        ///////////////

//shift+BKSPACE<>TILDE 
CBKS(&kp LA(N1), 0)                                                                                                                                                                                        CBKS(&mc_bkctilde U, 7) 
CBKS(&mc_bkctilde A, 10)                                                     CBKL(&mo DIRECTACC, 12)             CBKL(&mo NUMBERS, 13)                                              CBKS(&mc_ennesd N, 16)  CBKS(&mc_bkctilde E, 17)  CBKS(&mc_bkctilde I, 18)  CBKS(&mc_bkctilde O, 19)
CTKSPA(&lrlMo LA(LS(H)) LA(LS(F12)), 21)  CTKSPA(&td_find_s_ht A LG(F), 22)  CTKSPA(&td_find_g_ht A LG(LS(F)), 23)  CTKSPA(&kp LC(LS(MINUS)), 24)  CTKSPA(&kp LC(MINUS), 25)                                                                                    CBKS(&kp LS(LA(SLASH)), 30)    

//cmd+TAB<>DRAGTHUMB(inverted LOWER and DIRECTACC in low row only when DRAGTHUMB not activated)    
CTAB(&kp N1, 0)                          CTAB(&kp N2, 1)                   CTAB(&kp N3, 2)                       CTAB(&kp N4, 3)                  CTAB(&kp N5, 4)                CTAB(&kp N6, 5)  CTAB(&kp N7, 6)  CTAB(&kp N8, 7)  CTAB(&kp N9, 8)  CTAB(&kp N0, 9)
CTABD(&mhr LSHFT, 10)         CTABD(&mhr LCTRL, 11)  CTABD(&mhr LALT, 12)       CTABD(&mhr LGUI, 13)  

//alt+ENT<>RAISE
CENT(&kp EXCL, 0)  CENT(&kp AT, 1)    CENT(&kp HASH, 2)  CENT(&kp DLLR, 3)   CENT(&kp PRCNT, 4)          CENT(&kp CARET, 5)   CENT(&kp AMPS, 6)    CENT(&kp STAR, 7)    CENT(&kp LPAR, 8)  CENT(&kp RPAR, 9)
CENT(&kp PIPE, 10) CENT(&kp LBRC, 11) CENT(&kp RBRC, 12) CENT(&kp TILDE, 13) CENT(&kp UNDER, 14)         CENT(&kp PLUS, 15)   CENT(&kp COLON, 16)  CENT(&kp LT, 17)     CENT(&kp GT, 18)   CENT(&kp QUESTION, 19)
CENT(&kp BSLH, 21) CENT(&kp LBKT, 22) CENT(&kp RBKT, 23) CENT(&kp GRAVE, 24) CENT(&kp MINUS, 25)         CENT(&kp EQUAL, 26)  CENT(&kp SEMI, 27)   CENT(&kp COMMA, 28)  CENT(&kp DOT, 29)  CENT(&kp SLASH, 30)

//NAVOVERR+SPC<>NUMBERS
//CSPC(&kp EXCL, 0)   CSPC(&kp AT, 1)     CSPC(&kp HASH, 2)  CSPC(&kp DLLR, 3)   CSPC(&kp PRCNT, 4)         CSPC(&kp EQUAL, 5)  CSPC(&kp N7, 6)    CSPC(&kp N6, 7)   CSPC(&kp N8, 8)   CSPC(&kp STAR, 9)
//CSPC(&kp LSHFT, 10) CSPC(&kp LCTRL, 11) CSPC(&kp LALT, 12) CSPC(&kp LGUI, 13)  CSPC(&kp COMMA, 14)        CSPC(&kp DOT, 15)   CSPC(&kp N4, 16)   CSPC(&kp N5, 17)  CSPC(&kp N6, 18)  CSPC(&kp N0, 19)
//CSPC(&kp BSLH, 21) // CSPC(&kp LBKT, 22)  CSPC(&kp RBKT, 23) CSPC(&kp GRAVE, 24) CSPC(&kp MINUS, 25)      CSPC(&kp PLUS, 26)  CSPC(&kp N1, 27)   CSPC(&kp N2, 28)  CSPC(&kp N3, 29)  CSPC(&kp SLASH, 30)

//CSPCS(&kp Q, 0)   CSPCS(&kp W, 1)     CSPCS(&kp F, 2)  CSPCS(&kp P, 3)   CSPCS(&kp B, 4)         CSPCS(&kp J, 5)  CSPCS(&kp L, 6)    CSPCS(&kp U, 7)   CSPCS(&kp Y, 8)   CSPCS(&kp SQT, 9)
//CSPCS(&kp A, 10) CSPCS(&kp R, 11) CSPCS(&kp S, 12) CSPCS(&kp T, 13)  CSPCS(&kp G, 14)        CSPCS(&kp M, 15)   CSPCS(&kp N, 16)   CSPCS(&kp E, 17)  CSPCS(&kp I, 18)  CSPCS(&kp O, 19)
//CSPCS(&kp Z, 21) // CSPCS(&kp C, 22)  CSPCS(&kp C, 23) CSPCS(&kp D, 24) CSPCS(&kp V, 25)      CSPCS(&kp K, 26)  CSPCS(&kp H, 27)   CSPCS(&kp COMMA, 28)  CSPCS(&kp DOT, 29)  CSPCS(&kp SLASH, 30)
    };