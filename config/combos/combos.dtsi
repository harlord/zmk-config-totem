
#define COMBO(NAME, BINDINGS, KEYPOS) \
  combo_##NAME { \
    timeout-ms = <199>; \
    bindings = <BINDINGS>; \
    key-positions = <KEYPOS>; \
    slow-release; \
    layers = <BASE>; \
  };
#define RCOMBOACT(NAME, BINDINGS, KEYPOS) \
  combo_##NAME { \
    timeout-ms = <2000>; \
    bindings = <BINDINGS>; \
    key-positions = <KEYPOS>; \
    slow-release; \
    layers = <BASE NAVOVERR TILDESHIFTQUES DIRECTACC HOMEROW RAISE LOWER FUNC>; \
  };
#define RCOMBO(NAME, BINDINGS, KEYPOS) \
  combo_##NAME { \
    timeout-ms = <500>; \
    bindings = <BINDINGS>; \
    key-positions = <KEYPOS>; \
    require-prior-idle-ms = <150>; \
    layers = <BASE NAVOVERR TILDESHIFTQUES DIRECTACC HOMEROW RAISE LOWER FUNC>; \
  };
#define NAVBACOMBO(NAME, BINDINGS, KEYPOS) \
  combo_##NAME { \
    timeout-ms = <200>; \
    bindings = <BINDINGS>; \
    key-positions = <KEYPOS>; \
    layers = <NAVOVERR TILDESHIFTQUES>; \
  };
#define COMBODIRECTACC(NAME, BINDINGS, KEYPOS) \
  combo_##NAME { \
    timeout-ms = <500>; \
    bindings = <BINDINGS>; \
    key-positions = <KEYPOS>; \
    layers = <DIRECTACC>; \
  };
#define COMBOADJ(NAME, BINDINGS, KEYPOS) \
  combo_##NAME { \
    timeout-ms = <500>; \
    bindings = <BINDINGS>; \
    key-positions = <KEYPOS>; \
    layers = <ADJ>; \
  };

#define kcr(BINDINGS, KEYPOS) \
  combo_raise_##KEYPOS { \
    timeout-ms = <2000>; \
    bindings = <&km BINDINGS RAISE>; \
    key-positions = <KEYPOS 34>; \
    slow-release; \
    layers = <BASE>; \
  };

#define kcu(BINDINGS, KEYPOS) \
  combo_raise_##KEYPOS { \
    timeout-ms = <2000>; \
    bindings = <&km BINDINGS RAISE>; \
    key-positions = <KEYPOS>; \
    slow-release; \
    layers = <BASE>; \
  };

#define kcl(BINDINGS, KEYPOS) \
  combo_lower_##KEYPOS { \
    timeout-ms = <2000>; \
    bindings = <&km BINDINGS LOWER>; \
    key-positions = <KEYPOS 33>; \
    slow-release; \
    layers = <BASE>; \
  };
  

combos {
    compatible = "zmk,combos";
    // testgrave {
    //     bindings = <&kp  GRAVE>;
    //     key-positions = <13 24>;
    // };
    // top {
    //     bindings = <&none>;
    //     key-positions = <0 1 2 3 4>;
    // };
    // mid {
    //     bindings = <&none>;
    //     key-positions = <10 11 12 13 14>;
    // };
    // bottom {
    //     bindings = <&none>;
    //     key-positions = <21 22 23 24 25>;
    // };
    // topr {
    //     bindings = <&none>;
    //     key-positions = <5 6 7 8 9>;
    // };
    // midr {
    //     bindings = <&none>;
    //     key-positions = <15 16 17 18 19>;
    // };
    // bottomr {
    //     bindings = <&none>;
    //     key-positions = <26 27 28 29 30>;
    // };
    // thumb {
    //     bindings = <&none>;
    //     key-positions = <32 33 34>;
    // };
    // thumbr {
    //     bindings = <&none>;
    //     key-positions = <36 37 35>;
    // };


    //     0  1  2  3  4     5  6  7  8  9
    //    10 11 12 13 14    15 16 17 18 19
    //20  21 22 23 24 25    26 27 28 29 30  31
    //        32 33 34         35 36 37


    //LEFT HAND
    RCOMBOACT(comb_wf, &kp  ESC, 0 1 2)// Q W F
    RCOMBOACT(comb_fp, &kp  SPACE, 1 2 3)// W F P
    RCOMBOACT(comb_pb, &kp  ENTER, 3 4)// P B
    RCOMBOACT(comb_pb_2, &kp  ENTER, 12 3 13)// SPT
    RCOMBOACT(comb_tg_2, &kp  TAB, 23 13 24)// CDT
    RCOMBOACT(comb_tg, &kp  TAB, 24 25)// DV
    RCOMBOACT(comb_cd, &kp  BACKSPACE, 22 23 24)// X C D
    RCOMBOACT(comb_xc, &kp  DELETE, 21 22 23)// Z X C
    RCOMBO(comb_gv, &kp  MINUS, 14 25)// G V
    RCOMBO(comb_td, &kp  GRAVE, 13 24)// T D 
    RCOMBO(comb_sc, &kp  RBKT, 12 23)// S C
    RCOMBO(comb_rx, &kp  LBKT, 11 22)// R X
    RCOMBO(comb_az, &kp  BSLH, 10 21)// A Z
    //RIGHT HAND
    RCOMBO(requal, &kp  EQUAL, 15 26)
    RCOMBO(rsemi, &kp  SEMI, 16 27)
    RCOMBO(SEMI, &kp  COMMA, 17 28)
    RCOMBO(COLON, &kp  DOT, 18 29)
    RCOMBO(FSLH, &kp  FSLH, 19 30)
    //NUMBERS
    RCOMBO(NUM1, &kp  N1, 0 10)
    RCOMBO(NUM2, &kp  N2, 1 11)
    RCOMBO(NUM3, &kp  N3, 2 12)
    RCOMBO(NUM4, &kp  N4, 3 13)
    RCOMBO(NUM5, &kp  N5, 4 14)
    RCOMBO(NUM6, &kp  N6, 5 15)
    RCOMBO(NUM7, &kp  N7, 6 16)
    RCOMBO(NUM8, &kp  N8, 7 17) 
    RCOMBO(NUM9, &kp  N9, 8 18)
    RCOMBO(NUM0, &kp  N0, 9 19)
    //THUMBS
    COMBO(delete_space, &mo HOMEROW, 37 35)// ENTER SPACE
    COMBO(bkspace_delete2, &mo DIRECTACC, 34 32)// BKSPACE TAB
    COMBO(delete_enter, &sl FUNC, 32 37)// TAB ENTER
    //NavOverR
    NAVBACOMBO(pg_0, &kp  HOME, 27 28)// H , 
    NAVBACOMBO(pg_1, &kp  END, 28 29)// , .
    NAVBACOMBO(pg_4, &kp  PG_UP, 27 18)// , H 
    NAVBACOMBO(pg_5, &kp  PG_DN, 18 29)// H .
    // ADJUST
    COMBODIRECTACC(adj_tog_on, &tog_on ADJ,  0  1  2  3 )
    COMBOADJ(adj_tog_off, &tog_off ADJ,  0  1  2  3 )
   
    //     0  1  2  3  4     5  6  7  8  9
    //    10 11 12 13 14    15 16 17 18 19
    //20  21 22 23 24 25    26 27 28 29 30  31
    //        32 33 34         35 36 37
   
    //////////////////////////////////////
    c-hr-thumb-ar {
       bindings = <&kp  LS(LCTRL)>;
       key-positions = <33 10 11>;
       layers = <BASE TILDESHIFTA TILDESHIFTR TILDESHIFTS TILDESHIFTT>;
       slow-release;
       timeout-ms = <2000>;
   };
   c-hr-thumb-ars {
       bindings = <&kp  LS(LA(LCTRL))>;
       key-positions = <33 10 11 12>;
       layers = <BASE TILDESHIFTA TILDESHIFTR TILDESHIFTS TILDESHIFTT>;
       slow-release;
       timeout-ms = <2000>;
   };
   c-hr-thumb-arst {
       bindings = <&kp  LS(LA(LG(LCTRL)))>;
       key-positions = <33 10 11 12 13>;
       layers = <BASE TILDESHIFTA TILDESHIFTR TILDESHIFTS TILDESHIFTT>;
       slow-release;
       timeout-ms = <2000>;
   };
   c-hr-thumb-art {
       bindings = <&kp  LS(LC(LCMD))>;
       key-positions = <33 10 11 13>;
       layers = <BASE TILDESHIFTA TILDESHIFTR TILDESHIFTS TILDESHIFTT>;
       slow-release;
       timeout-ms = <2000>;
   };
   c-hr-thumb-ast {
       bindings = <&kp  LS(LA(LCMD))>;
       key-positions = <33 10 13 12>;
       layers = <BASE TILDESHIFTA TILDESHIFTR TILDESHIFTS TILDESHIFTT>;
       slow-release;
       timeout-ms = <2000>;
   };
   c-hr-thumb-rst {
       bindings = <&kp  LA(LC(LCMD))>;
       key-positions = <33 13 12 11>;
       layers = <BASE TILDESHIFTA TILDESHIFTR TILDESHIFTS TILDESHIFTT>;
       slow-release;
       timeout-ms = <2000>;
   };
   c-hr-thumb-at {
       bindings = <&kp  LS(LCMD)>;
       key-positions = <33 13 10>;
       layers = <BASE TILDESHIFTA TILDESHIFTR TILDESHIFTS TILDESHIFTT>;
       slow-release;
       timeout-ms = <2000>;
   };
   c-hr-thumb-st {
       bindings = <&kp  LA(LCMD)>;
       key-positions = <33 12 13>;
       layers = <BASE TILDESHIFTA TILDESHIFTR TILDESHIFTS TILDESHIFTT>;
       slow-release;
       timeout-ms = <2000>;
   };
   c-hr-thumb-rs {
       bindings = <&kp  LC(LALT)>;
       key-positions = <33 12 11>;
       layers = <BASE TILDESHIFTA TILDESHIFTR TILDESHIFTS TILDESHIFTT>;
       slow-release;
       timeout-ms = <2000>;
   };
   c-hr-thumb-rt {
       bindings = <&kp  LC(LCMD)>;
       key-positions = <33 13 11>;
       layers = <BASE TILDESHIFTA TILDESHIFTR TILDESHIFTS TILDESHIFTT>;
       slow-release;
       timeout-ms = <2000>;
   };
   c-hr-thumb-as {
       bindings = <&kp  LS(LALT)>;
       key-positions = <33 10 12>;
       layers = <BASE TILDESHIFTA TILDESHIFTR TILDESHIFTS TILDESHIFTT>;
       slow-release;
       timeout-ms = <2000>;
   };

    //     0  1  2  3  4     5  6  7  8  9
    //    10 11 12 13 14    15 16 17 18 19
    //20  21 22 23 24 25    26 27 28 29 30  31
    //        32 33 34         35 36 37

   // RAISE 
   kcr(EXCL, 0)   kcr(AT, 1)     kcr(HASH, 2)   kcr(DLLR, 3)    kcr(PRCNT, 4)       kcr(CARET, 5)   kcr(AMPS, 6)    kcr(STAR, 7)    kcr(LPAR, 8)  kcr(RPAR, 9) 
   kcr(PIPE, 10)  kcr(LBRC, 11)  kcr(RBRC, 12)  kcr(TILDE, 13)  kcr(UNDER, 14)      kcr(PLUS, 15)   kcr(COLON, 16)  kcr(LT, 17)     kcr(GT, 18)   kcr(QUESTION, 19)
   kcr(BSLH, 21)  kcr(LBKT, 22)  kcr(RBKT, 23)  kcr(GRAVE, 24)  kcr(MINUS, 25)      kcr(EQUAL, 26)  kcr(SEMI, 27)   kcr(COMMA, 28)  kcr(DOT, 29)  kcr(SLASH, 30)              

   kcu(EXCL, U)

   // LOWER
   kcl(N1, 0)     kcl(N2, 1)     kcl(N3, 2)     kcl(N4, 3)      kcl(N5, 4)          kcl(N6, 5)      kcl(N7, 6)     kcl(N8, 7)     kcl(N9, 8)      kcl(N0, 9)
   kcl(BSLH, 21)  kcl(LBKT, 22)  kcl(RBKT, 23)  kcl(GRAVE, 24)  kcl(MINUS, 25)      kcl(EQUAL, 26)  kcl(LEFT, 27)  kcl(DOWN, 28)  kcl(RIGHT, 29)  kcl(SLASH, 30)


};